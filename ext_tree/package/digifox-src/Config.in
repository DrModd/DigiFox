## ext_tree/package/digifox-src/Config.in
```kconfig
config BR2_PACKAGE_DIGIFOX_SRC
	bool "digifox-src"
	depends on BR2_PACKAGE_ALSA_LIB
	select BR2_PACKAGE_LIBSOXR
	help
	  DigiFox sample-rate conversion for amplifiers without the AK4137:
	  ALSA plugin "digifox" (everything -> PCM 192 kHz / 32 bit:
	  PCM through soxr, DSD64..DSD256 through a multi-stage decimator)
	  and the digifox-srcbench CPU load test.
```

## ext_tree/package/digifox-srcbench/Config.in
```kconfig
config BR2_PACKAGE_DIGIFOX_SRCBENCH
	bool "digifox-srcbench"
	select BR2_PACKAGE_LIBSOXR
	help
	  DigiFox: CPU load of PCM resampling to 192 kHz (soxr) and
	  DSD to PCM conversion, to see whether the Fox can replace the
	  AK4137 sample-rate converter of the DigiD D1 amplifier.
```

## ext_tree/package/go-librespot/Config.in
```kconfig
config BR2_PACKAGE_GO_LIBRESPOT
    bool "go-librespot"
    depends on BR2_arm
    select BR2_PACKAGE_ALSA_LIB
    help
      Spotify Connect client in Go (devgianlu/go-librespot), with a REST API
      and WebSocket events: play/pause/next/prev/seek and track metadata.
      Prebuilt release binary (linux armv6 build, ARMv7 code, glibc,
      needs libasound). Installed as /usr/lib/go-librespot/librespot so the
      existing service detection ("librespot") keeps working.
      https://github.com/devgianlu/go-librespot
```

## ext_tree/package/pfrate/Config.in
```kconfig
config BR2_PACKAGE_PFRATE
	bool "pfrate"
	help
	  DigiFox: instant stream rate/format reports (@RATE) for the
	  DigiD D1 amplifier, started by "pfctl serve" on the console UART.
```

## ext_tree/package/qobine/Config.in
```kconfig
config BR2_PACKAGE_QOBINE
    bool "qobine (Qobuz Connect, open source)"
    depends on BR2_PACKAGE_HOST_RUSTC_TARGET_ARCH_SUPPORTS
    select BR2_PACKAGE_HOST_RUSTC
    select BR2_PACKAGE_ALSA_LIB
    select BR2_PACKAGE_OPENSSL
    help
      Open source Qobuz Connect renderer (SofusA/qobine, connect-module,
      binary qobine-connect). Installed as /usr/lib/qobine/qobuz-connect:
      the process name stays "qobuz-connect", so service detection works.
      Chosen instead of the SDK player by /etc/digifox/qobuz-engine = qobine.
      https://github.com/SofusA/qobine
```
